## share/build/conf/bblayers.conf
```bitbake
# POKY_BBLAYERS_CONF_VERSION is increased each time build/conf/bblayers.conf
# changes incompatibly
POKY_BBLAYERS_CONF_VERSION = "2"

BBPATH = "${TOPDIR}"
BBFILES ?= ""

BBLAYERS ?= " \
  /share/poky/meta \
  /share/poky/meta-poky \
  /share/poky/meta-yocto-bsp \
  /share/meta-tegra \
  "
```
